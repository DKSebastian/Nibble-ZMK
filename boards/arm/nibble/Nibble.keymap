/*
 * Copyright (c) 2020 The ZMK Contributors
 *
 * SPDX-License-Identifier: MIT
 */

#include <behaviors.dtsi>
#include <dt-bindings/zmk/keys.h>
#include <dt-bindings/zmk/bt.h>
#include <dt-bindings/zmk/rgb.h>
#include <../boards/shields/nibble/boards/nice_nano.overlay>

/ {
	sensors {
		compatible = "zmk,keymap-sensors";
		sensors = <&encoder_1>;
	};

	keymap {
		compatible = "zmk,keymap";

		default_layer {
			label = "Default";

			sensor-bindings = <&inc_dec_kp C_VOLUME_UP C_VOLUME_DOWN>;

			bindings = <
            &kp ESC   &kp N1    &kp N2    &kp N3    &kp N4    &kp N5    &kp N6    &kp N7    &kp N8  &kp N9    &kp N0    &kp MINUS &kp EQUAL &kp BSPC &kp HOME
&kp C_MUTE  &kp TAB   &kp Q     &kp W     &kp E     &kp R     &kp T     &kp Y     &kp U     &kp I   &kp O     &kp P     &kp LBKT  &kp RBKT  &kp BSLH &kp DEL
&trans      &kp CLCK  &kp A     &kp S     &kp D     &kp F     &kp G     &kp H     &kp J     &kp K   &kp L     &kp SEMI  &kp SQT             &kp RET  &kp PG_UP
&trans      &kp LSHFT &trans    &kp Z     &kp X     &kp C     &kp V     &kp B     &kp N     &kp M   &kp COMMA &kp DOT   &kp FSLH  &kp RSHFT &kp UP   &kp PG_DN
&trans      &kp LCTRL &kp LGUI  &kp LALT                      &kp SPACE                     &kp RALT  &mo 1   &kp RCTRL &kp LEFT            &kp DOWN &kp RIGHT
			>;
		};
		function_layer {
			label = "Function";
			
			sensor-bindings = <&inc_dec_kp C_VOLUME_UP C_VOLUME_DOWN>;

			bindings = <
            &kp TILDE &kp F1    &kp F2    &kp F3    &kp F4    &kp F5    &kp F6    &kp F7    &kp F8  &kp F9    &kp F10   &kp F11   &kp F12   &trans   &kp END
&kp C_MUTE  &trans    &trans    &trans    &trans    &trans    &trans    &trans    &trans    &trans  &trans    &trans    &trans    &trans    &trans   &bootloader
&bt BT_CLR  &trans    &trans    &trans    &trans    &trans    &trans    &trans    &trans    &trans  &trans    &trans    &trans              &trans   &trans
&bt BT_PRV  &trans    &trans    &trans    &trans    &trans    &trans    &trans    &trans    &trans  &trans    &trans    &trans    &trans    &trans   &trans
&bt BT_NXT  &trans    &trans    &trans                        &trans                        &trans  &trans    &trans    &kp C_PREV          &kp C_PP &kp C_NEXT
			>;
		};
	};
};

            bindings = <&kp>, <&kp>;
        };
    };

    keymap {
        compatible = "zmk,keymap";

        default_layer {
            label = "Base";
            bindings = <
                &kp Q      &kp W      &kp E       &kp R          &kp T         &kp Y            &kp U          &kp I       &kp O      &kp P
                &hm LGUI A &hm LALT S &hm LCTRL D &hm LSHFT F    &kp G         &kp H            &hm RSHFT J    &hm RCTRL K &hm LALT L &hm LGUI QUOT
                &kp Z      &kp X      &kp C       &kp V          &kp B         &kp N            &kp M          &kp COMMA   &kp DOT    &kp FSLH
                                                  &lt NAV_L TAB  &lt OTH_L RET &lt NUM_L SPACE  &lt SYM_L BKSP
            >;
        };

        nav_layer {
            label = "Nav";
            bindings = <
                &trans     &trans     &trans      &trans          &trans       &trans           &trans         &trans      &trans     &trans
                &trans     &trans     &trans      &trans          &trans       &trans           &kp LARW       &kp DARW    &kp UARW   &kp RARW
                &trans     &trans     &trans      &trans          &trans       &trans           &kp HOME       &kp PG_DN   &kp PG_UP  &kp END
                                                  &trans          &trans       &kp ESC          &kp DEL
            >;
        };

        other_layer {
            label = "Other";
            bindings = <
                &trans	   &trans     &trans      &trans          &trans       &trans           &trans         &trans       &trans       &bt BT_CLR
                &trans     &trans     &trans      &trans          &trans       &trans           &trans         &trans       &trans       &trans
                &trans     &trans     &trans      &trans          &trans       &bt BT_SEL 0     &bt BT_SEL 1   &bt BT_SEL 2 &bt BT_SEL 3 &bt BT_SEL 4
                                                  &trans          &trans       &trans           &trans
            >;
        };

        num_layer {
            label = "Num";
            bindings = <
                &kp LBKT   &kp N7     &kp N8      &kp N9          &kp RBKT      &trans          &trans         &trans      &trans     &trans
                &kp SEMI   &kp N4     &kp N5      &kp N6          &kp EQUAL     &trans          &trans         &trans      &trans     &trans
                &kp GRAVE  &kp N1     &kp N2      &kp N3          &kp BSLH      &trans          &trans         &trans      &trans     &trans
                                                  &kp N0          &kp MINUS     &trans          &trans
            >;
        };

        sym_layer {
            label = "Sym";
            bindings = <
                &kp LBRC     &kp LS(N7)  &kp LS(N8)  &kp LS(N9) &kp RBRC        &trans &trans   &trans    &trans    &trans
                &kp COLON    &kp LS(N4)  &kp LS(N5)  &kp LS(N6) &kp PLUS        &trans &trans   &trans    &trans    &trans
                &kp TILDE    &kp LS(N1)  &kp LS(N2)  &kp LS(N3) &kp LS(BSLH)    &trans &trans   &trans    &trans    &trans
                                                   &kp LS(N0) &kp UNDER         &trans &trans
            >;
        };

        media_layer {
            label = "Media";
            bindings = <
                &trans	   &trans     &trans      &trans          &trans       &trans           &trans         &trans       &trans       &trans
                &trans     &trans     &trans      &trans          &trans       &trans           &kp C_PREV     &kp C_VOL_DN &kp C_VOL_UP &kp C_NEXT
                &trans     &trans     &trans      &trans          &trans       &trans           &trans         &trans       &trans       &trans
                                                  &trans          &trans       &kp C_STOP       &kp C_PLAY_PAUSE
            >;
        };

        fun_layer {
            label = "Fun";
            bindings = <
                &kp F12     &kp F7     &kp F8      &kp F9     &kp PSCRN         &trans          &trans         &trans      &trans     &trans
                &kp F11     &kp F4     &kp F5      &kp F6     &kp SLCK          &trans          &trans         &trans      &trans     &trans
                &kp F10     &kp F1     &kp F2      &kp F3     &kp PAUSE_BREAK   &trans          &trans         &trans      &trans     &trans
                                                   &none      &none             &trans          &trans
            >;
        };
    };
};

